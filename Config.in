## configs/ros_raspi3_defconfig
```kconfig
BR2_arm=y
BR2_cortex_a53=y
BR2_ARM_FPU_NEON_VFPV4=y
BR2_TOOLCHAIN_BUILDROOT_GLIBC=y
BR2_PACKAGE_HOST_LINUX_HEADERS_CUSTOM_4_19=y
BR2_TOOLCHAIN_BUILDROOT_CXX=y
BR2_SYSTEM_DHCP="eth0"
BR2_ROOTFS_POST_BUILD_SCRIPT="board/raspberrypi3/post-build.sh"
BR2_ROOTFS_POST_IMAGE_SCRIPT="board/raspberrypi3/post-image.sh"
BR2_ROOTFS_POST_SCRIPT_ARGS="--add-pi3-miniuart-bt-overlay"
BR2_LINUX_KERNEL=y
BR2_LINUX_KERNEL_CUSTOM_TARBALL=y
BR2_LINUX_KERNEL_CUSTOM_TARBALL_LOCATION="$(call github,raspberrypi,linux,5eeff139ea9135db6e01a58ef613338f1d0899d8)/linux-5eeff139ea9135db6e01a58ef613338f1d0899d8.tar.gz"
BR2_LINUX_KERNEL_DEFCONFIG="bcm2709"
BR2_LINUX_KERNEL_DTS_SUPPORT=y
BR2_LINUX_KERNEL_INTREE_DTS_NAME="bcm2710-rpi-3-b bcm2710-rpi-3-b-plus bcm2710-rpi-cm3"
BR2_LINUX_KERNEL_NEEDS_HOST_OPENSSL=y
BR2_PACKAGE_RPI_FIRMWARE=y
BR2_PACKAGE_PYTHON=y
BR2_PACKAGE_LOG4CXX=y
BR2_PACKAGE_BOOST=y
BR2_PACKAGE_BOOST_IOSTREAMS=y
BR2_PACKAGE_BOOST_LOG=y
BR2_PACKAGE_BOOST_MATH=y
BR2_PACKAGE_BOOST_PROGRAM_OPTIONS=y
BR2_PACKAGE_BOOST_PYTHON=y
BR2_PACKAGE_BOOST_SERIALIZATION=y
BR2_TARGET_ROOTFS_EXT2=y
BR2_TARGET_ROOTFS_EXT2_4=y
BR2_TARGET_ROOTFS_EXT2_SIZE="120M"
# BR2_TARGET_ROOTFS_TAR is not set
BR2_PACKAGE_HOST_DOSFSTOOLS=y
BR2_PACKAGE_HOST_GENIMAGE=y
BR2_PACKAGE_HOST_MTOOLS=y
BR2_PACKAGE_ROS=y
BR2_PACKAGE_ROS_DEVTOOLS=y
BR2_PACKAGE_PYTHON_ROSDEP=y
BR2_PACKAGE_ROS_PLUGINS=y
```

## package/Config.in
```kconfig
source "$BR2_EXTERNAL_ROS_PATH/package/zziplib/Config.in"
source "$BR2_EXTERNAL_ROS_PATH/package/ogre/Config.in"

menu "Python Host packages"
	source "$BR2_EXTERNAL_ROS_PATH/package/python-pyparsing-host/Config.in"
	source "$BR2_EXTERNAL_ROS_PATH/package/python-pyyaml-host/Config.in"
	source "$BR2_EXTERNAL_ROS_PATH/package/python-dateutil-host/Config.in"
endmenu

menu "Python packages"
	source "$BR2_EXTERNAL_ROS_PATH/package/python-empy/Config.in"
	source "$BR2_EXTERNAL_ROS_PATH/package/python-bson/Config.in"
	source "$BR2_EXTERNAL_ROS_PATH/package/python-defusedxml/Config.in"
	source "$BR2_EXTERNAL_ROS_PATH/package/python-future/Config.in"
	source "$BR2_EXTERNAL_ROS_PATH/package/python-gnupg/Config.in"
	source "$BR2_EXTERNAL_ROS_PATH/package/python-pbr/Config.in"
	source "$BR2_EXTERNAL_ROS_PATH/package/python-vcstools/Config.in"
	source "$BR2_EXTERNAL_ROS_PATH/package/python-wstool/Config.in"
endmenu

source "$BR2_EXTERNAL_ROS_PATH/package/ros/Config.in"
```

## package/catkin/Config.in
```kconfig
config BR2_PACKAGE_CMAKE_FOR_CATKIN
	bool
	select BR2_PACKAGE_XZ
	select BR2_PACKAGE_RHASH
	select BR2_PACKAGE_LIBUV
	select BR2_PACKAGE_LIBCURL
	select BR2_PACKAGE_LIBARCHIVE
	select BR2_PACKAGE_JSONCPP
	select BR2_PACKAGE_CMAKE

config BR2_PACKAGE_CATKIN
	bool "catkin"
	select BR2_PACKAGE_CMAKE_FOR_CATKIN
	select BR2_PACKAGE_PYTHON_CATKIN_PKG
	select BR2_PACKAGE_PYTHON_EMPY
	help
	  catkin tools.

	  https://github.com/ros/catkin.git
```

## package/common_msgs/Config.in
```kconfig
config BR2_PACKAGE_ROS_COMMON_MSGS
	bool
	depends on BR2_PACKAGE_ROS_PLUGINS
	select BR2_PACKAGE_MESSAGE_GENERATION
	select BR2_PACKAGE_STD_MSGS
```

## package/common_msgs/common_msgs_actionlib_msgs/Config.in
```kconfig
config BR2_PACKAGE_COMMON_MSGS_ACTIONLIB_MSGS
	bool
	depends on BR2_PACKAGE_COMMON_MSGS
```

## package/common_msgs/common_msgs_common_msgs/Config.in
```kconfig
config BR2_PACKAGE_COMMON_MSGS_COMMON_MSGS
	bool
	depends on BR2_PACKAGE_COMMON_MSGS
```

## package/common_msgs/common_msgs_diagnostic_msgs/Config.in
```kconfig
config BR2_PACKAGE_COMMON_MSGS_DIAGNOSTIC_MSGS
	bool
	depends on BR2_PACKAGE_COMMON_MSGS
```

## package/common_msgs/common_msgs_geometry_msgs/Config.in
```kconfig
config BR2_PACKAGE_COMMON_MSGS_GEOMETRY_MSGS
	bool
	depends on BR2_PACKAGE_COMMON_MSGS
```

## package/common_msgs/common_msgs_nav_msgs/Config.in
```kconfig
config BR2_PACKAGE_COMMON_MSGS_NAV_MSGS
	bool
	depends on BR2_PACKAGE_COMMON_MSGS
```

## package/common_msgs/common_msgs_sensor_msgs/Config.in
```kconfig
config BR2_PACKAGE_COMMON_MSGS_SENSOR_MSGS
	bool
	depends on BR2_PACKAGE_COMMON_MSGS
```

## package/common_msgs/common_msgs_shape_msgs/Config.in
```kconfig
config BR2_PACKAGE_COMMON_MSGS_SHAPE_MSGS
	bool
	depends on BR2_PACKAGE_COMMON_MSGS
```

## package/common_msgs/common_msgs_stereo_msgs/Config.in
```kconfig
config BR2_PACKAGE_COMMON_MSGS_STEREO_MSGS
	bool
	depends on BR2_PACKAGE_COMMON_MSGS
```

## package/common_msgs/common_msgs_trajectory_msgs/Config.in
```kconfig
config BR2_PACKAGE_COMMON_MSGS_TRAJECTORY_MSGS
	bool
	depends on BR2_PACKAGE_COMMON_MSGS
```

## package/common_msgs/common_msgs_visualization_msgs/Config.in
```kconfig
config BR2_PACKAGE_COMMON_MSGS_VISUALIZATION_MSGS
	bool
	depends on BR2_PACKAGE_COMMON_MSGS
```

## package/genpy/Config.in
```kconfig
config BR2_PACKAGE_GENPY
	bool
	select BR2_PACKAGE_GENMSG
	select BR2_PACKAGE_PYTHON_PYYAML_HOST
```

## package/ogre/Config.in
```kconfig
config BR2_PACKAGE_OGRE
	bool "OGRE: 3D graphics rendering engine"
	depends on BR2_PACKAGE_ZZIPLIB
	depends on BR2_PACKAGE_FREETYPE
	depends on BR2_PACKAGE_XORG7
	depends on BR2_PACKAGE_XLIB_LIBX11
	depends on BR2_PACKAGE_XLIB_LIBXAW
```
