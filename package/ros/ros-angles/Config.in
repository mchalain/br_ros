## package/ros/ros-comm/Config.in
```kconfig
config BR2_PACKAGE_ROS_COMM
	bool
	depends on BR2_PACKAGE_ROS
	select BR2_PACKAGE_ROS_PLUGINLIB
	select BR2_PACKAGE_ROS_COMM_MSGS
	select BR2_PACKAGE_MESSAGE_FILTERS
	select BR2_PACKAGE_ROSLZ4
	select BR2_PACKAGE_ROSWTF
	select BR2_PACKAGE_XMLRPCPP
	select BR2_PACKAGE_CLIENT_ROSCPP
	select BR2_PACKAGE_CLIENT_ROSPY
	select BR2_PACKAGE_ROSBAG
	select BR2_PACKAGE_ROSGRAPH
	select BR2_PACKAGE_ROSLAUNCH
	select BR2_PACKAGE_ROSMASTER
	select BR2_PACKAGE_ROSMSG
	select BR2_PACKAGE_ROSNODE
	select BR2_PACKAGE_ROSPARAM
	select BR2_PACKAGE_ROSSERVICE

config BR2_PACKAGE_CLIENT_ROSCPP
	bool
	depends on BR2_PACKAGE_ROS_COMM
	select BR2_PACKAGE_BOOST_CHRONO
	select BR2_PACKAGE_BOOST_SIGNALS
	select BR2_PACKAGE_ROSCPP

config BR2_PACKAGE_CLIENT_ROSPY
	bool
	depends on BR2_PACKAGE_ROS_COMM
	select BR2_PACKAGE_PYTHON

config BR2_PACKAGE_ROSBAG
	bool
	select BR2_PACKAGE_ROSBAG_STORAGE
	select BR2_PACKAGE_TOPIC_TOOLS

config BR2_PACKAGE_ROSBAG_STORAGE
	bool
	depends on BR2_PACKAGE_ROS_COMM
	select BR2_PACKAGE_PYTHON

config BR2_PACKAGE_ROSGRAPH
	bool
	depends on BR2_PACKAGE_ROS_COMM
	select BR2_PACKAGE_PYTHON

config BR2_PACKAGE_ROSLAUNCH
	bool
	depends on BR2_PACKAGE_ROS_COMM
	select BR2_PACKAGE_PYTHON

config BR2_PACKAGE_ROSMASTER
	bool
	depends on BR2_PACKAGE_ROS_COMM
	select BR2_PACKAGE_PYTHON

config BR2_PACKAGE_ROSMSG
	bool
	depends on BR2_PACKAGE_ROS_COMM
	select BR2_PACKAGE_PYTHON

config BR2_PACKAGE_ROSNODE
	bool
	depends on BR2_PACKAGE_ROS_COMM
	select BR2_PACKAGE_PYTHON

config BR2_PACKAGE_ROSOUT
	bool
	depends on BR2_PACKAGE_ROS_COMM
	select BR2_PACKAGE_BOOST

config BR2_PACKAGE_ROSPARAM
	bool
	depends on BR2_PACKAGE_ROS_COMM
	select BR2_PACKAGE_PYTHON

config BR2_PACKAGE_ROSSERVICE
	bool
	depends on BR2_PACKAGE_ROS_COMM
	select BR2_PACKAGE_PYTHON

config BR2_PACKAGE_ROSTOPIC
	bool
	depends on BR2_PACKAGE_ROS_COMM
	select BR2_PACKAGE_PYTHON

config BR2_PACKAGE_TOPIC_TOOLS
	bool
	depends on BR2_PACKAGE_ROS_COMM
	select BR2_PACKAGE_PYTHON

config BR2_PACKAGE_XMLRPCPP
	bool
	depends on BR2_PACKAGE_ROS_COMM
	select BR2_PACKAGE_ROSCPP

config BR2_PACKAGE_MESSAGE_FILTERS
	bool
	depends on BR2_PACKAGE_ROS_COMM
	select BR2_PACKAGE_PYTHON

config BR2_PACKAGE_ROSLZ4
	bool
	depends on BR2_PACKAGE_ROS_COMM
	select BR2_PACKAGE_PYTHON
	select BR2_PACKAGE_LZ4
	select BR2_PACKAGE_LIBGPGME

config BR2_PACKAGE_ROSWTF
	bool
	depends on BR2_PACKAGE_ROS_COMM
	select BR2_PACKAGE_PYTHON
```

## package/ros/ros-common_msgs/Config.in
```kconfig
config BR2_PACKAGE_ROS_COMMON_MSGS
	bool "Common messages"
	depends on BR2_PACKAGE_ROS
	select BR2_PACKAGE_MESSAGE_GENERATION
	select BR2_PACKAGE_STD_MSGS
	select BR2_PACKAGE_COMMON_MSGS_ACTIONLIB_MSGS
	select BR2_PACKAGE_COMMON_MSGS_COMMON_MSGS
	select BR2_PACKAGE_COMMON_MSGS_DIAGNOSTIC_MSGS
	select BR2_PACKAGE_COMMON_MSGS_GEOMETRY_MSGS
	select BR2_PACKAGE_COMMON_MSGS_NAV_MSGS
	select BR2_PACKAGE_COMMON_MSGS_SENSOR_MSGS
	select BR2_PACKAGE_COMMON_MSGS_SHAPE_MSGS
	select BR2_PACKAGE_COMMON_MSGS_STEREO_MSGS
	select BR2_PACKAGE_COMMON_MSGS_TRAJECTORY_MSGS
	select BR2_PACKAGE_COMMON_MSGS_VISUALIZATION_MSGS

config BR2_PACKAGE_COMMON_MSGS_ACTIONLIB_MSGS
	bool
	depends on BR2_PACKAGE_COMMON_MSGS

config BR2_PACKAGE_COMMON_MSGS_COMMON_MSGS
	bool
	depends on BR2_PACKAGE_COMMON_MSGS

config BR2_PACKAGE_COMMON_MSGS_DIAGNOSTIC_MSGS
	bool
	depends on BR2_PACKAGE_COMMON_MSGS

config BR2_PACKAGE_COMMON_MSGS_GEOMETRY_MSGS
	bool
	depends on BR2_PACKAGE_COMMON_MSGS

config BR2_PACKAGE_COMMON_MSGS_NAV_MSGS
	bool
	depends on BR2_PACKAGE_COMMON_MSGS

config BR2_PACKAGE_COMMON_MSGS_SENSOR_MSGS
	bool
	depends on BR2_PACKAGE_COMMON_MSGS


config BR2_PACKAGE_COMMON_MSGS_SHAPE_MSGS
	bool
	depends on BR2_PACKAGE_COMMON_MSGS

config BR2_PACKAGE_COMMON_MSGS_STEREO_MSGS
	bool
	depends on BR2_PACKAGE_COMMON_MSGS

config BR2_PACKAGE_COMMON_MSGS_TRAJECTORY_MSGS
	bool
	depends on BR2_PACKAGE_COMMON_MSGS

config BR2_PACKAGE_COMMON_MSGS_VISUALIZATION_MSGS
	bool
	depends on BR2_PACKAGE_COMMON_MSGS
```

## package/ros/ros-roslib/Config.in
```kconfig
config BR2_PACKAGE_ROS_ROSLIB
	bool
	dependes on BR2_PACKAGE_ROS_PLUGINS
	select BR2_PACKAGE_BOOST
	select BR2_PACKAGE_BOOST_FILESYSTEM
	select BR2_PACKAGE_BOOST_SYSTEM
	select BR2_PACKAGE_BOOST_PROGRAM_OPTIONS
	select BR2_PACKAGE_BOOST_THREAD
```

## package/ros/rosconsole/Config.in
```kconfig
config BR2_PACKAGE_ROSCONSOLE
	bool
	depends on BR2_PACKAGE_ROS
	select BR2_PACKAGE_CONSOLE_BRIDGE
```

## package/ros/rospack/Config.in
```kconfig
config BR2_PACKAGE_ROSPACK
	bool
	depends on BR2_PACKAGE_CMAKE_MODULES
	select BR2_PACKAGE_TINYXML
	select BR2_PACKAGE_BOOST
	select BR2_PACKAGE_BOOST_FILESYSTEM
	select BR2_PACKAGE_BOOST_SYSTEM
	select BR2_PACKAGE_BOOST_PROGRAM_OPTIONS
```

## package/ros/urdf/Config.in
```kconfig
config BR2_PACKAGE_URDF
	bool
	depends on BR2_PACKAGE_ROS
	select BR2_PACKAGE_URDFDOM_HEADERS
	select BR2_PACKAGE_URDF_PARSER_PLUGIN
	select BR2_PACKAGE_URDFDOM
	select BR2_PACKAGE_ROSCONSOLE_BRIDGE

config BR2_PACKAGE_URDF_PARSER_PLUGIN
	bool
	depends on BR2_PACKAGE_ROS
```

## package/rosconsole-bridge/Config.in
```kconfig
config BR2_PACKAGE_ROSCONSOLE_BRIDGE
	bool
	depends on BR2_PACKAGE_ROS
	select BR2_PACKAGE_BOOST_CHRONO
	select BR2_PACKAGE_BOOST_SIGNALS
```

## package/roscpp/Config.in
```kconfig
config BR2_PACKAGE_BOOST_FOR_ROSCPP
	bool
	select BR2_PACKAGE_BOOST_DATE_TIME
	select BR2_PACKAGE_BOOST_THREAD
	select BR2_PACKAGE_BOOST_SYSTEM

config BR2_PACKAGE_ROSCPP
	bool "framework cpp"
	depends on BR2_PACKAGE_ROS_FRAMEWORK
	select BR2_PACKAGE_BOOST_FOR_ROSCPP
	select BR2_PACKAGE_MESSAGE_RUNTIME
	select BR2_PACKAGE_ROSCPP_CPPCOMMON
	select BR2_PACKAGE_ROSCPP_ROSCPP_SERIALIZATION
	select BR2_PACKAGE_ROSCPP_ROSCPP_TRAITS
	select BR2_PACKAGE_ROSCPP_ROSTIME

config BR2_PACKAGE_MESSAGE_RUNTIME
	bool
	depends on BR2_PACKAGE_ROSCPP

config BR2_PACKAGE_ROSCPP_CPPCOMMON
	bool
	depends on BR2_PACKAGE_ROSCPP
	depends on BR2_PACKAGE_CONSOLE_BRIDGE

config BR2_PACKAGE_ROSCPP_ROSTIME
	bool
	depends on BR2_PACKAGE_ROSCPP

config BR2_PACKAGE_ROSCPP_ROSCPP_SERIALIZATION
	bool
	depends on BR2_PACKAGE_ROSCPP
	select BR2_PACKAGE_ROSCPP_ROSCPP_TRAITS

config BR2_PACKAGE_ROSCPP_ROSCPP_TRAITS
	bool
	depends on BR2_PACKAGE_ROSCPP
```

## package/rospack/Config.in
```kconfig
config BR2_PACKAGE_ROSPACK
	bool
	select BR2_PACKAGE_BOOST
	select BR2_PACKAGE_BOOST_FILESYSTEM
	select BR2_PACKAGE_BOOST_SYSTEM
	select BR2_PACKAGE_BOOST_PROGRAM_OPTIONS
```

## package/rviz/Config.in
```kconfig
config BR2_PACKAGE_RVIZ
	bool
	depends on BR2_PACKAGE_ROS
	select BR2_PACKAGE_PYTHON
	select BR2_PACKAGE_ASSIMP
	select BR2_PACKAGE_QT5BASE_GUI
	select BR2_PACKAGE_OGRE
	select BR2_PACKAGE_URDF
	select BR2_PACKAGE_COMMON_MSGS
```

## package/std_msgs/Config.in
```kconfig
config BR2_PACKAGE_STD_MSGS
	bool
	select BR2_PACKAGE_GENMSG
	select BR2_PACKAGE_GENPY
	select BR2_PACKAGE_GENEUS
	select BR2_PACKAGE_GENCPP
	select BR2_PACKAGE_GENLISP
	select BR2_PACKAGE_GENNODEJS
```
