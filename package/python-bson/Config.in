## package/python-bson/Config.in
```kconfig
config BR2_PACKAGE_PYTHON_BSON
	bool "python-bson"
	select BR2_PACKAGE_PYTHON_DATEUTIL # runtime
	select BR2_PACKAGE_PYTHON_SIX # runtime
	help
	  BSON codec for Python.

	  http://github.com/py-bson/bson
```

## package/python-empy/Config.in
```kconfig
config BR2_PACKAGE_PYTHON_EMPY
	bool "python-empy"
	help
	  empy package library.

	  http://www.alcyone.com/software/empy/
```

## package/python-future/Config.in
```kconfig
config BR2_PACKAGE_PYTHON_FUTURE
	bool "python-future"
	help
	  Clean single-source support for Python 3 and 2.

	  https://python-future.org
```

## package/python-gnupg/Config.in
```kconfig
config BR2_PACKAGE_PYTHON_GNUPG
	bool "python-gnupg"
	select BR2_PACKAGE_PYTHON_PSUTIL # runtime
	help
	  A Python wrapper for GnuPG.

	  https://github.com/isislovecruft/python-gnupg
```

## package/python-numpy-host/Config.in
```kconfig
config BR2_PACKAGE_PYTHON_NUMPY_HOST
	bool "python-numpy for host"
	help
	  NumPy is the fundamental package for scientific computing
	  with Python.

	  Note that NumPy needs fenv.h fully supported by the
	  C library.

	  http://www.numpy.org/
```

## package/python-pbr/Config.in
```kconfig
config BR2_PACKAGE_PYTHON_PBR
	bool "python-pbr"
	help
	  Python Build Reasonableness.

	  https://docs.openstack.org/pbr/latest/
```

## package/python-pyparsing-host/Config.in
```kconfig
config BR2_PACKAGE_PYTHON_PYPARSING_HOST
	bool "python-pyparsing for host tools"
	help
	  Python parsing module.

	  https://github.com/pyparsing/pyparsing/
```

## package/python-pyyaml-host/Config.in
```kconfig
config BR2_PACKAGE_PYTHON_PYYAML_HOST
	bool "python-pyyaml-host"
	select BR2_PACKAGE_LIBYAML
	help
	  The PyYAML package contains binding to the libyaml API.

	  http://pyyaml.org/
```

## package/python-rosdep/Config.in
```kconfig
config BR2_PACKAGE_PYTHON_ROSDEP
	bool "python-rosdep"
	select BR2_PACKAGE_PYTHON_CATKIN_PKG # runtime
	select BR2_PACKAGE_PYTHON_ROSPKG # runtime
	select BR2_PACKAGE_PYTHON_ROSDISTRO # runtime
	select BR2_PACKAGE_PYTHON_PYYAML # runtime
	help
	  rosdep package manager abstraction tool for ROS.

	  http://wiki.ros.org/rosdep
```

## package/python-vcstools/Config.in
```kconfig
config BR2_PACKAGE_PYTHON_VCSTOOLS
	bool "python-vcstools"
	select BR2_PACKAGE_PYTHON_PYYAML # runtime
	select BR2_PACKAGE_PYTHON_DATEUTIL # runtime
	help
	  VCS/SCM source control library for svn, git, hg, and bzr.

	  http://wiki.ros.org/vcstools
```

## package/python-wstool/Config.in
```kconfig
config BR2_PACKAGE_PYTHON_WSTOOL
	bool "python-wstool"
	select BR2_PACKAGE_PYTHON_VCSTOOLS # runtime
	select BR2_PACKAGE_PYTHON_PYYAML # runtime
	help
	  workspace multi-SCM commands.

	  http://wiki.ros.org/wstool
```

## package/ros-comm-msgs/Config.in
```kconfig
config BR2_PACKAGE_ROS_COMM_MSGS
	bool
	depends on BR2_PACKAGE_ROS
	select BR2_PACKAGE_ROSGRAPH_MSGS
	select BR2_PACKAGE_STD_SRVS

config BR2_PACKAGE_ROSGRAPH_MSGS
	bool
	select BR2_PACKAGE_STD_MSGS
	select BR2_PACKAGE_MESSAGE_GENERATION

config BR2_PACKAGE_STD_SRVS
	bool
```

## package/ros-comm/Config.in
```kconfig
config BR2_PACKAGE_ROS_COMM
	bool
	depends on BR2_PACKAGE_ROS
	depends on BR2_PACKAGE_ROS_COMM_MSGS
	select BR2_PACKAGE_CLIENT_ROSCPP
	select BR2_PACKAGE_XMLRPCPP

config BR2_PACKAGE_CLIENT_ROSCPP
	bool
	depends on BR2_PACKAGE_ROSCPP

config BR2_PACKAGE_XMLRPCPP
	bool
	depends on BR2_PACKAGE_ROSCPP
```

## package/ros-pluginlib/Config.in
```kconfig
config BR2_PACKAGE_ROS_PLUGINLIB
	bool
	select BR2_PACKAGE_BOOST_REGEX
	select BR2_PACKAGE_BOOST_THREAD
	select BR2_PACKAGE_BOOST_SYSTEM
	select BR2_PACKAGE_BOOST_FILESYSTEM
	select BR2_PACKAGE_BOOST_IOSTREAMS
```

## package/ros/Config.in
```kconfig
config BR2_PACKAGE_GLIBC_FOR_ROS
	bool "ROS: select glibc inside the Toolchain"
	depends on ! BR2_TOOLCHAIN_USES_GLIBC
	default y

menuconfig BR2_PACKAGE_ROS
	bool "ROS: Robot OS"
	depends on BR2_TOOLCHAIN_USES_GLIBC
	select BR2_PACKAGE_PYTHON

config BR2_PACKAGE_ROS_INSTALL_PREFIX
	depends on BR2_PACKAGE_ROS
	string "ROS: installation directory"
	default: /opt/ros

menuconfig BR2_PACKAGE_ROS_DEVTOOLS
	bool "devtools: Host tools for ROS distribution"
	depends on BR2_PACKAGE_ROS
	select BR2_PACKAGE_PYTHON_BSON
	select BR2_PACKAGE_PYTHON_DATEUTIL
	select BR2_PACKAGE_PYTHON_DEFUSEDXML
	select BR2_PACKAGE_PYTHON_EMPY
	select BR2_PACKAGE_PYTHON_FUTURE
	select BR2_PACKAGE_PYTHON_PBR
	select BR2_PACKAGE_PYTHON_PYPARSING
	select BR2_PACKAGE_PYTHON_SIX
	select BR2_PACKAGE_PYTHON_ECDSA
	select BR2_PACKAGE_PYTHON_NETIFACES
	select BR2_PACKAGE_PYTHON_PARAMIKO
	select BR2_PACKAGE_PYTHON_PYCURL
	select BR2_PACKAGE_PYTHON_PYPROJ
	select BR2_PACKAGE_PYTHON_VCSTOOLS
	select BR2_PACKAGE_PYTHON_WSTOOL
	select BR2_PACKAGE_CATKIN
	select BR2_PACKAGE_CMAKE_MODULES

if BR2_PACKAGE_ROS_DEVTOOLS
	source "$BR2_EXTERNAL_ROS_PATH/package/ros/python-rosdep/Config.in"
	source "$BR2_EXTERNAL_ROS_PATH/package/ros/python-catkin-pkg/Config.in"
	source "$BR2_EXTERNAL_ROS_PATH/package/ros/python-rospkg/Config.in"
	source "$BR2_EXTERNAL_ROS_PATH/package/ros/catkin/Config.in"
	source "$BR2_EXTERNAL_ROS_PATH/package/ros/cmake-modules/Config.in"
endif

menuconfig BR2_PACKAGE_ROS_PLUGINS
	bool "plugins: Target framework for ROS distribution"
	depends on BR2_PACKAGE_ROS
	select BR2_PACKAGE_ROSPACK
	select BR2_PACKAGE_ROS_FRAMEWORK
	select BR2_PACKAGE_CLASS_LOADER
	select BR2_PACKAGE_ROS_COMMON_MSGS
	select BR2_PACKAGE_MESSAGE_RUNTIME
	select BR2_PACKAGE_CONSOLE_BRIDGE
	select BR2_PACKAGE_ROSCPP
	select BR2_PACKAGE_ROS_COMM
	select BR2_PACKAGE_ROS_COMM_MSGS
	select BR2_PACKAGE_CONSOLE_BRIDGE
	select BR2_PACKAGE_ROSCONSOLE
	select BR2_PACKAGE_ROSCONSOLE_BRIDGE

if BR2_PACKAGE_ROS_PLUGINS
	source "$BR2_EXTERNAL_ROS_PATH/package/ros/rospack/Config.in"
	source "$BR2_EXTERNAL_ROS_PATH/package/ros/core/Config.in"
	source "$BR2_EXTERNAL_ROS_PATH/package/ros/class-loader/Config.in"
	source "$BR2_EXTERNAL_ROS_PATH/package/ros/console-bridge/Config.in"
	source "$BR2_EXTERNAL_ROS_PATH/package/ros/rosconsole/Config.in"
	source "$BR2_EXTERNAL_ROS_PATH/package/ros/rosconsole-bridge/Config.in"
	source "$BR2_EXTERNAL_ROS_PATH/package/ros/roscpp/Config.in"
	source "$BR2_EXTERNAL_ROS_PATH/package/ros/ros-actionlib/Config.in"
	source "$BR2_EXTERNAL_ROS_PATH/package/ros/ros-pluginlib/Config.in"
	source "$BR2_EXTERNAL_ROS_PATH/package/ros/ros-comm/Config.in"
	source "$BR2_EXTERNAL_ROS_PATH/package/ros/ros-comm-msgs/Config.in"
	source "$BR2_EXTERNAL_ROS_PATH/package/ros/ros-common_msgs/Config.in"
	source "$BR2_EXTERNAL_ROS_PATH/package/ros/std_msgs/Config.in"
	source "$BR2_EXTERNAL_ROS_PATH/package/ros/message_generation/Config.in"
	source "$BR2_EXTERNAL_ROS_PATH/package/ros/gencpp/Config.in"
	source "$BR2_EXTERNAL_ROS_PATH/package/ros/geneus/Config.in"
	source "$BR2_EXTERNAL_ROS_PATH/package/ros/genlisp/Config.in"
	source "$BR2_EXTERNAL_ROS_PATH/package/ros/genmsg/Config.in"
	source "$BR2_EXTERNAL_ROS_PATH/package/ros/gennodejs/Config.in"
	source "$BR2_EXTERNAL_ROS_PATH/package/ros/genpy/Config.in"

	config BR2_PACKAGE_ROS_PLUGINS_VISUALIZATION
		bool "Visualization on X11"
		select BR2_PACKAGE_RVIZ
	source "$BR2_EXTERNAL_ROS_PATH/package/ros/urdfdom-headers/Config.in"
	source "$BR2_EXTERNAL_ROS_PATH/package/ros/urdfdom/Config.in"
	source "$BR2_EXTERNAL_ROS_PATH/package/ros/urdf/Config.in"
	source "$BR2_EXTERNAL_ROS_PATH/package/ros/rviz/Config.in"
endif
```

## package/ros/perception/Config.in
```kconfig
config BR2_PACKAGE_ROS_PERCEPTION
	bool "Perception"
	depends on BR2_PACKAGE_ROS_PLUGINS
	select BR2_PACKAGE_ROS_IMAGE_COMMON
	select BR2_PACKAGE_ROS_IMAGE_PIPELINE

source "$BR2_EXTERNAL_ROS_PATH/package/ros/perception/ros-image_common/Config.in"
source "$BR2_EXTERNAL_ROS_PATH/package/ros/perception/ros-vision_opencv/Config.in"
source "$BR2_EXTERNAL_ROS_PATH/package/ros/perception/ros-image_pipeline/Config.in"
```

## package/ros/perception/ros-image_common/Config.in
```kconfig
config BR2_PACKAGE_ROS_IMAGE_COMMON
	bool
	select BR2_PACKAGE_GENMSG
	select BR2_PACKAGE_GENPY
	select BR2_PACKAGE_GENEUS
	select BR2_PACKAGE_GENCPP
	select BR2_PACKAGE_GENLISP
	select BR2_PACKAGE_GENNODEJS
	select BR2_PACKAGE_ROS_IMAGE_TRANSPORT
	select BR2_PACKAGE_ROS_CAMERA_CALIBRATION_PARSERS
	select BR2_PACKAGE_ROS_CAMERA_INFO_MANAGER
	select BR2_PACKAGE_ROS_POLLED_CAMERA

config BR2_PACKAGE_ROS_IMAGE_TRANSPORT
	bool
	depends on BR2_PACKAGE_ROS_IMAGE_COMMON

config BR2_PACKAGE_ROS_CAMERA_CALIBRATION_PARSERS
	bool
	depends on BR2_PACKAGE_ROS_IMAGE_COMMON
	select BR2_PACKAGE_BOOST_PYTHON
	select BR2_PACKAGE_YAML_CPP

config BR2_PACKAGE_ROS_CAMERA_INFO_MANAGER
	bool
	depends on BR2_PACKAGE_ROS_IMAGE_COMMON

config BR2_PACKAGE_ROS_POLLED_CAMERA
	bool
	depends on BR2_PACKAGE_ROS_IMAGE_COMMON
```

## package/ros/perception/ros-image_pipeline/Config.in
```kconfig
config BR2_PACKAGE_ROS_IMAGE_PIPELINE
	bool
	select BR2_PACKAGE_ROS_STEREO_IMAGE_PROC
	select BR2_PACKAGE_ROS_DEPTH_IMAGE_PROC
	select BR2_PACKAGE_ROS_CAMERA_CALIBRATION
	select BR2_PACKAGE_ROS_IMAGE_PROC
	select BR2_PACKAGE_ROS_IMAGE_PUBLISHER
	select BR2_PACKAGE_ROS_IMAGE_ROTATE
	select BR2_PACKAGE_ROS_IMAGE_VIEW

config BR2_PACKAGE_ROS_STEREO_IMAGE_PROC
	bool
	depends on BR2_PACKAGE_ROS_IMAGE_PIPELINE

config BR2_PACKAGE_ROS_DEPTH_IMAGE_PROC
	bool
	depends on BR2_PACKAGE_ROS_IMAGE_PIPELINE
	select BR2_PACKAGE_ROS_VISION_OPENCV

config BR2_PACKAGE_ROS_CAMERA_CALIBRATION
	bool
	depends on BR2_PACKAGE_ROS_IMAGE_PIPELINE

config BR2_PACKAGE_ROS_IMAGE_PROC
	bool
	depends on BR2_PACKAGE_ROS_IMAGE_PIPELINE

config BR2_PACKAGE_ROS_IMAGE_ROTATE
	bool
	depends on BR2_PACKAGE_ROS_IMAGE_PIPELINE

config BR2_PACKAGE_ROS_IMAGE_PUBLISHER
	bool
	depends on BR2_PACKAGE_ROS_IMAGE_PIPELINE

config BR2_PACKAGE_ROS_IMAGE_VIEW
	bool
	depends on BR2_PACKAGE_ROS_IMAGE_PIPELINE
```

## package/ros/perception/ros-vision_opencv/Config.in
```kconfig
config BR2_PACKAGE_ROS_VISION_OPENCV
	bool
	select BR2_PACKAGE_OPENCV3
	select BR2_PACKAGE_ROS_IMAGE_GEOMETRY
	select BR2_PACKAGE_ROS_CV_BRIDGE

config BR2_PACKAGE_ROS_IMAGE_GEOMETRY
	bool
	depends on BR2_PACKAGE_ROS_VISION_OPENCV

config BR2_PACKAGE_ROS_CV_BRIDGE
	bool
	depends on BR2_PACKAGE_ROS_VISION_OPENCV
	select BR2_PACKAGE_PYTHON_NUMPY_HOST
```

## package/ros/python-catkin-pkg/Config.in
```kconfig
config BR2_PACKAGE_PYTHON_CATKIN_PKG
	bool "python-catkin-pkg"
	select BR2_PACKAGE_PYTHON_DOCUTILS # runtime
	select BR2_PACKAGE_PYTHON_DATEUTIL # runtime
	select BR2_PACKAGE_PYTHON_PYPARSING # runtime
	help
	  catkin package library.

	  http://wiki.ros.org/catkin_pkg
```

## package/ros/python-rospkg/Config.in
```kconfig
config BR2_PACKAGE_PYTHON_ROSPKG
	bool "python-rospkg"
	select BR2_PACKAGE_PYTHON_CATKIN_PKG # runtime
	select BR2_PACKAGE_PYTHON_PYYAML # runtime
	help
	  ROS package library.

	  http://wiki.ros.org/rospkg
```

## package/ros/ros-actionlib/Config.in
```kconfig
config BR2_PACKAGE_ROS_ACTIONLIB
	bool
	select BR2_PACKAGE_COMMON_MSGS_ACTIONLIB_MSGS
```
